## config/west.yml
```yaml
manifest:
  remotes:
    - name: zmkfirmware
      url-base: https://github.com/zmkfirmware
    - name: SethMilliken
      url-base: https://github.com/SethMilliken
    - name: issmirnov
      url-base: https://github.com/issmirnov
    # Additional modules containing boards/shields/custom code can be listed here as well
    # See https://docs.zephyrproject.org/3.2.0/develop/west/manifest.html#projects
  projects:
    - name: zmk
      remote: issmirnov
      revision: fix-lvgl9-logos
      import: app/west.yml
  self:
    path: config
```
